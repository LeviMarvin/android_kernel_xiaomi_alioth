// SPDX-License-Identifier: GPL-2.0
/*
 * Copyright (c) 2022, The Linux Foundation. All rights reserved.
 */

/dts-v1/;
/plugin/;

#include <dt-bindings/interrupt-controller/arm-gic.h>
#include "kona-alioth.dtsi"

/ {
	model = "Xiaomi Inc. MSM sm8250 Alioth";
	compatible = "qcom,kona";
	qcom,msm-id = <356 0x20000>;
	qcom,board-id = <44 0>;
};
