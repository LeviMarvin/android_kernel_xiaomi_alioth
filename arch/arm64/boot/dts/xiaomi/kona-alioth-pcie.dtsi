// SPDX-License-Identifier: GPL-2.0
/* Copyright (c) 2022, The Linux Foundation. All rights reserved.
 *
 * This program is free software; you can redistribute it and/or modify
 * it under the terms of the GNU General Public License version 2 and
 * only version 2 as published by the Free Software Foundation.
 *
 * This program is distributed in the hope that it will be useful,
 * but WITHOUT ANY WARRANTY; without even the implied warranty of
 * MERCHANTABILITY or FITNESS FOR A PARTICULAR PURPOSE.  See the
 * GNU General Public License for more details.
 */

&wlan {
    vdd-wlan-dig-supply = <&pm8150_s6>;
    qcom,vdd-wlan-dig-config = <950000 950000 0 0 1>;
};

&bluetooth {
    qca,bt-vdd-dig-supply = <&pm8150_s6>;
    qca,bt-vdd-dig-voltage-level = <950000 950000>;
};
