// SPDX-License-Identifier: GPL-2.0
/* Copyright (c) 2022, The Linux Foundation. All rights reserved.
 *
 * This program is free software; you can redistribute it and/or modify
 * it under the terms of the GNU General Public License version 2 and
 * only version 2 as published by the Free Software Foundation.
 *
 * This program is distributed in the hope that it will be useful,
 * but WITHOUT ANY WARRANTY; without even the implied warranty of
 * MERCHANTABILITY or FITNESS FOR A PARTICULAR PURPOSE.  See the
 * GNU General Public License for more details.
 */

#include "kona-gourami-common.dtsi"
#include "kona-munch-audio.dtsi"
#include "kona-munch-battery.dtsi"
#include "kona-munch-camera-sensor.dtsi"
#include "kona-munch-display.dtsi"
#include "kona-munch-fingerprint.dtsi"
#include "kona-munch-haptics.dtsi"
#include "kona-munch-pcie.dtsi"
#include "kona-munch-pinctrl.dtsi"
#include "kona-munch-regulators.dtsi"
#include "kona-munch-thermal.dtsi"
#include "kona-munch-touch.dtsi"
#include "kona-munch-usb.dtsi"
