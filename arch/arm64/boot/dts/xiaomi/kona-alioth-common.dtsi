// SPDX-License-Identifier: GPL-2.0
/* Copyright (c) 2022, The Linux Foundation. All rights reserved.
 *
 * This program is free software; you can redistribute it and/or modify
 * it under the terms of the GNU General Public License version 2 and
 * only version 2 as published by the Free Software Foundation.
 *
 * This program is distributed in the hope that it will be useful,
 * but WITHOUT ANY WARRANTY; without even the implied warranty of
 * MERCHANTABILITY or FITNESS FOR A PARTICULAR PURPOSE.  See the
 * GNU General Public License for more details.
 */

#include "kona-gourami-common.dtsi"
#include "kona-alioth-audio.dtsi"
#include "kona-alioth-battery.dtsi"
#include "kona-alioth-camera-sensor.dtsi"
#include "kona-alioth-display.dtsi"
#include "kona-alioth-fingerprint.dtsi"
#include "kona-alioth-haptics.dtsi"
#include "kona-alioth-memory.dtsi"
#include "kona-alioth-pcie.dtsi"
#include "kona-alioth-pinctrl.dtsi"
#include "kona-alioth-regulators.dtsi"
#include "kona-alioth-thermal.dtsi"
#include "kona-alioth-touch.dtsi"
#include "kona-alioth-usb.dtsi"
