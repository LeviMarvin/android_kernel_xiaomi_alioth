// SPDX-License-Identifier: GPL-2.0
/* Copyright (c) 2016-2022, The Linux Foundation. All rights reserved.
 *
 * This program is free software; you can redistribute it and/or modify
 * it under the terms of the GNU General Public License version 2 and
 * only version 2 as published by the Free Software Foundation.
 *
 * This program is distributed in the hope that it will be useful,
 * but WITHOUT ANY WARRANTY; without even the implied warranty of
 * MERCHANTABILITY or FITNESS FOR A PARTICULAR PURPOSE.  See the
 * GNU General Public License for more details.
 */

/* kona-gourami memory includes go here */

/*
 * Reverved memory carveout is defined in TZ project:
 * ssg/securemsm/trustzone/qsee/mink/oem/config/saipan/oem_config.xml

/*
 * the following carveout items are still defined in kona.dtsi:
 * region              address    size
 * ==========          ========== =========
 * removed_mem:        0x80b00000 0x5700000
 * qcom_seecom:        0x82400000 0x3E00000
 */

&removed_mem {
    reg = <0x0 0x80b00000 0x0 0x5700000>;
};

&qcom_seecom {
    reg = <0x82400000 0x3E00000>;
};
