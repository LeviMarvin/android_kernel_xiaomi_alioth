// SPDX-License-Identifier: GPL-2.0
/* Copyright (c) 2022, The Linux Foundation. All rights reserved.
 *
 * This program is free software; you can redistribute it and/or modify
 * it under the terms of the GNU General Public License version 2 and
 * only version 2 as published by the Free Software Foundation.
 *
 * This program is distributed in the hope that it will be useful,
 * but WITHOUT ANY WARRANTY; without even the implied warranty of
 * MERCHANTABILITY or FITNESS FOR A PARTICULAR PURPOSE.  See the
 * GNU General Public License for more details.
 */

&soc {
	xiaomi_touch {
		status = "ok";
		compatible = "xiaomi-touch";
		touch,name = "xiaomi-touch";
	};
};

&qupv3_se4_spi {
	status = "ok";

	focaltech {
		status = "ok";
		compatible = "focaltech,fts";
		reg = <0x0>;
		spi-max-frequency = <10000000>;
		interrupt-parent = <&tlmm>;
		interrupts = <39 0x2008>;
		pinctrl-names = "pmx_ts_active", "pmx_ts_suspend", "pmx_ts_release";
		pinctrl-0 = <&ts_active>;
		pinctrl-1 = <&ts_int_suspend &ts_reset_suspend>;
		pinctrl-2 = <&pmx_ts_release>;
		vdd-supply = <&L10C>;
		vcc_i2c-supply = <&L1C>;
		focaltech,reset-gpio = <&tlmm 33 0x00>;
		focaltech,irq-gpio = <&tlmm 39 0x2008>;
		focaltech,max-touch-number = <10>;
		focaltech,display-coords = <0 0 1080 2400>;
		focaltech,open-min = <3000>;
		focaltech,touch-range-array = <1 5 10 15 20>;
		focaltech,touch-def-array = <3 3 3 3>;
		focaltech,touch-expert-array = <10 10 10 10
						20 20 15 10
						20 20 20 10>;
	};
};
