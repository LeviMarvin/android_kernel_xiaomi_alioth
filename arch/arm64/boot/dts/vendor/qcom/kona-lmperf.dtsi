/* LMPERF Kernel dtsi */
&reserved_memory {
	ramoops: ramoops@0xb0000000 {
	    compatible = "ramoops";
	    no-map;
	    reg = <0x0 0xb0000000 0x0 0x00400000>;
	    record-size =   <0x40000>; //256x1024
	    console-size =  <0x40000>;
	    ftrace-size =   <0x40000>;
	    pmsg-size =     <0x200000>;
	    ecc-size =  <0x0>;
	};
};